## yocto/meta-lattice-tablet/conf/distro/lattice-tablet.conf
```bitbake
require conf/distro/poky.conf

DISTRO = "lattice-tablet"
DISTRO_NAME = "Lattice Tablet"
DISTRO_VERSION = "0.1.0"
DISTRO_CODENAME = "foundation"
MAINTAINER = "Lattice"
```

## yocto/meta-lattice-tablet/conf/layer.conf
```bitbake
BBPATH .= ":${LAYERDIR}"
BBFILES += "${LAYERDIR}/recipes-*/*/*.bb ${LAYERDIR}/recipes-*/*/*.bbappend"

BBFILE_COLLECTIONS += "lattice-tablet"
BBFILE_PATTERN_lattice-tablet = "^${LAYERDIR}/"
BBFILE_PRIORITY_lattice-tablet = "8"

LAYERSERIES_COMPAT_lattice-tablet = "scarthgap"
```
